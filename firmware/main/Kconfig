## firmware/main/Kconfig
```kconfig
menu "EspScope Configuration"
    config AP_NAME
        string "AP Name"
        default "EspScope"
        help
            Access Point name

    config AP_PASSWORD
        string "WiFi AP password"
        default "12345678"
        help
            Password for the ESP32 SoftAP.
            Must be at least 8 characters for WPA2.

    config ADC_CHAN_CUSTOM
        bool "Use custom ADC channel"
        default n

    config ADC_CHAN
        int "ADC channel"
        depends on ADC_CHAN_CUSTOM
        range 0 4
        default 0

endmenu
```
